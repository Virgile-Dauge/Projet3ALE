## package/LEDController/Config.in
```kconfig
config BR2_PACKAGE_LEDCONTROLLER
	bool LEDController
	help
	  driver LEDController
```

## package/helloWorld/Config.in
```kconfig
config BR2_PACKAGE_HELLOWORLD
       bool helloWorld
       help
       technologie du futur
```

## package/pinController/Config.in
```kconfig
config BR2_PACKAGE_PINCONTROLLER
	bool pinController
	help
	  driver pineController
```
